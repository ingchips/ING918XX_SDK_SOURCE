/***********************************************************
Based on source code from Yk Technology
***********************************************************/

#include "Display_LCD.h"
#include <string.h>

const unsigned char num[]={
0x00,0xF8,0xFC,0x04,0x04,0xFC,0xF8,0x00,0x00,0x03,0x07,0x04,0x04,0x07,0x03,0x00,  	   /*--  文字:  0~9  --*/
0x00,0x00,0x08,0xFC,0xFC,0x00,0x00,0x00,0x00,0x00,0x04,0x07,0x07,0x04,0x00,0x00,  
0x00,0x18,0x1C,0x84,0xC4,0x7C,0x38,0x00,0x00,0x06,0x07,0x05,0x04,0x04,0x04,0x00,
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0x00,0x78,0xFC,0x84,0xC4,0xFC,0xF8,0x00,0x00,0x06,0x06,0x04,0x06,0x03,0x01,0x00
};

const unsigned char  Bmp001[40][17]=
{
/*------------------------------------------------------------------------------
;  若数据乱码，请检查字模格式设置，注意选择正确的取模方向和字节位顺序。
;  源文件 / 文字 : 0
;  宽×高（像素）: 7×13
;  字模格式/大小 : 单色点阵液晶字模，纵向取模，字节倒序/14字节
;  数据转换日期  : 2014-6-17 19:47:28
------------------------------------------------------------------------------*/
0x07,0x0D,0x01,//宽的像素数,高的像素数，宽的字节数，参数设置可选
0x00,0xF8,0x04,0x04,0x04,0xF8,0x00,0x00,0x03,0x04,0x04,0x04,0x03,0x00,

/*------------------------------------------------------------------------------
;  若数据乱码，请检查字模格式设置，注意选择正确的取模方向和字节位顺序。
;  源文件 / 文字 : 1
;  宽×高（像素）: 7×13
;  字模格式/大小 : 单色点阵液晶字模，纵向取模，字节倒序/14字节
;  数据转换日期  : 2014-6-17 19:47:28
------------------------------------------------------------------------------*/
0x07,0x0D,0x01,//宽的像素数,高的像素数，宽的字节数，参数设置可选
0x00,0x00,0x08,0xFC,0x00,0x00,0x00,0x00,0x00,0x04,0x07,0x04,0x00,0x00,

/*------------------------------------------------------------------------------
;  若数据乱码，请检查字模格式设置，注意选择正确的取模方向和字节位顺序。
;  源文件 / 文字 : 2
;  宽×高（像素）: 7×13
;  字模格式/大小 : 单色点阵液晶字模，纵向取模，字节倒序/14字节
;  数据转换日期  : 2014-6-17 19:47:28
------------------------------------------------------------------------------*/
0x07,0x0D,0x01,//宽的像素数,高的像素数，宽的字节数，参数设置可选
0x00,0x18,0x04,0x84,0x44,0x38,0x00,0x00,0x06,0x05,0x04,0x04,0x04,0x00,

/*------------------------------------------------------------------------------
;  若数据乱码，请检查字模格式设置，注意选择正确的取模方向和字节位顺序。
;  源文件 / 文字 : 3
;  宽×高（像素）: 7×13
;  字模格式/大小 : 单色点阵液晶字模，纵向取模，字节倒序/14字节
;  数据转换日期  : 2014-6-17 19:47:28
------------------------------------------------------------------------------*/
0x07,0x0D,0x01,//宽的像素数,高的像素数，宽的字节数，参数设置可选
0x00,0x08,0x04,0x24,0x24,0xD8,0x00,0x00,0x02,0x04,0x04,0x04,0x03,0x00,

/*------------------------------------------------------------------------------
;  若数据乱码，请检查字模格式设置，注意选择正确的取模方向和字节位顺序。
;  源文件 / 文字 : 4
;  宽×高（像素）: 7×13
;  字模格式/大小 : 单色点阵液晶字模，纵向取模，字节倒序/14字节
;  数据转换日期  : 2014-6-17 19:47:28
------------------------------------------------------------------------------*/
0x07,0x0D,0x01,//宽的像素数,高的像素数，宽的字节数，参数设置可选
0x80,0x60,0x10,0x08,0xFC,0x00,0x00,0x00,0x01,0x01,0x05,0x07,0x04,0x00,

/*------------------------------------------------------------------------------
;  若数据乱码，请检查字模格式设置，注意选择正确的取模方向和字节位顺序。
;  源文件 / 文字 : 5
;  宽×高（像素）: 7×13
;  字模格式/大小 : 单色点阵液晶字模，纵向取模，字节倒序/14字节
;  数据转换日期  : 2014-6-17 19:47:28
------------------------------------------------------------------------------*/
0x07,0x0D,0x01,//宽的像素数,高的像素数，宽的字节数，参数设置可选
0x00,0x7C,0x24,0x24,0x24,0xC4,0x00,0x00,0x03,0x04,0x04,0x04,0x03,0x00,

/*------------------------------------------------------------------------------
;  若数据乱码，请检查字模格式设置，注意选择正确的取模方向和字节位顺序。
;  源文件 / 文字 : 6
;  宽×高（像素）: 7×13
;  字模格式/大小 : 单色点阵液晶字模，纵向取模，字节倒序/14字节
;  数据转换日期  : 2014-6-17 19:47:28
------------------------------------------------------------------------------*/
0x07,0x0D,0x01,//宽的像素数,高的像素数，宽的字节数，参数设置可选
0x00,0xF0,0x48,0x24,0x24,0xCC,0x00,0x00,0x03,0x04,0x04,0x04,0x03,0x00,

/*------------------------------------------------------------------------------
;  若数据乱码，请检查字模格式设置，注意选择正确的取模方向和字节位顺序。
;  源文件 / 文字 : 7
;  宽×高（像素）: 7×13
;  字模格式/大小 : 单色点阵液晶字模，纵向取模，字节倒序/14字节
;  数据转换日期  : 2014-6-17 19:47:28
------------------------------------------------------------------------------*/
0x07,0x0D,0x01,//宽的像素数,高的像素数，宽的字节数，参数设置可选
0x00,0x0C,0x04,0xC4,0x3C,0x04,0x00,0x00,0x00,0x00,0x07,0x00,0x00,0x00,

/*------------------------------------------------------------------------------
;  若数据乱码，请检查字模格式设置，注意选择正确的取模方向和字节位顺序。
;  源文件 / 文字 : 8
;  宽×高（像素）: 7×13
;  字模格式/大小 : 单色点阵液晶字模，纵向取模，字节倒序/14字节
;  数据转换日期  : 2014-6-17 19:47:28
------------------------------------------------------------------------------*/
0x07,0x0D,0x01,//宽的像素数,高的像素数，宽的字节数，参数设置可选
0x00,0x98,0x64,0x44,0x64,0x98,0x00,0x00,0x03,0x04,0x04,0x04,0x03,0x00,

/*------------------------------------------------------------------------------
;  若数据乱码，请检查字模格式设置，注意选择正确的取模方向和字节位顺序。
;  源文件 / 文字 : 9
;  宽×高（像素）: 7×13
;  字模格式/大小 : 单色点阵液晶字模，纵向取模，字节倒序/14字节
;  数据转换日期  : 2014-6-17 19:47:28
------------------------------------------------------------------------------*/
0x07,0x0D,0x01,//宽的像素数,高的像素数，宽的字节数，参数设置可选
0x00,0x78,0x84,0x84,0x44,0xF8,0x00,0x00,0x06,0x04,0x04,0x02,0x01,0x00,

/*------------------------------------------------------------------------------
;  若数据乱码，请检查字模格式设置，注意选择正确的取模方向和字节位顺序。
;  源文件 / 文字 : .
;  宽×高（像素）: 7×13
;  字模格式/大小 : 单色点阵液晶字模，纵向取模，字节倒序/14字节
;  数据转换日期  : 2014-6-17 19:47:28
------------------------------------------------------------------------------*/
0x07,0x0D,0x01,//宽的像素数,高的像素数，宽的字节数，参数设置可选
0x00,0x00,0x00,0x00,0x00,0x00,0x00,0x00,0x06,0x06,0x00,0x00,0x00,0x00,

/*------------------------------------------------------------------------------
;  若数据乱码，请检查字模格式设置，注意选择正确的取模方向和字节位顺序。
;  源文件 / 文字 : :
;  宽×高（像素）: 7×13
;  字模格式/大小 : 单色点阵液晶字模，纵向取模，字节倒序/14字节
;  数据转换日期  : 2014-6-17 19:47:28
------------------------------------------------------------------------------*/
0x07,0x0D,0x01,//宽的像素数,高的像素数，宽的字节数，参数设置可选
0x00,0x00,0x60,0x60,0x00,0x00,0x00,0x00,0x00,0x06,0x06,0x00,0x00,0x00,

/*------------------------------------------------------------------------------
;  若数据乱码，请检查字模格式设置，注意选择正确的取模方向和字节位顺序。
;  源文件 / 文字 : A
;  宽×高（像素）: 7×13
;  字模格式/大小 : 单色点阵液晶字模，纵向取模，字节倒序/14字节
;  数据转换日期  : 2014-6-17 19:47:28
------------------------------------------------------------------------------*/
0x07,0x0D,0x01,//宽的像素数,高的像素数，宽的字节数，参数设置可选
0x00,0x00,0xF0,0x8C,0xF0,0x00,0x00,0x04,0x07,0x04,0x00,0x04,0x07,0x04,

/*------------------------------------------------------------------------------
;  若数据乱码，请检查字模格式设置，注意选择正确的取模方向和字节位顺序。
;  源文件 / 文字 : B
;  宽×高（像素）: 7×13
;  字模格式/大小 : 单色点阵液晶字模，纵向取模，字节倒序/14字节
;  数据转换日期  : 2014-6-17 19:47:28
------------------------------------------------------------------------------*/
0x07,0x0D,0x01,//宽的像素数,高的像素数，宽的字节数，参数设置可选
0x04,0xFC,0x24,0x24,0x24,0xD8,0x00,0x04,0x07,0x04,0x04,0x04,0x03,0x00,

/*------------------------------------------------------------------------------
;  若数据乱码，请检查字模格式设置，注意选择正确的取模方向和字节位顺序。
;  源文件 / 文字 : C
;  宽×高（像素）: 7×13
;  字模格式/大小 : 单色点阵液晶字模，纵向取模，字节倒序/14字节
;  数据转换日期  : 2014-6-17 19:47:28
------------------------------------------------------------------------------*/
0x07,0x0D,0x01,//宽的像素数,高的像素数，宽的字节数，参数设置可选
0xF0,0x08,0x04,0x04,0x04,0x0C,0x00,0x01,0x02,0x04,0x04,0x04,0x02,0x00,

/*------------------------------------------------------------------------------
;  若数据乱码，请检查字模格式设置，注意选择正确的取模方向和字节位顺序。
;  源文件 / 文字 : D
;  宽×高（像素）: 7×13
;  字模格式/大小 : 单色点阵液晶字模，纵向取模，字节倒序/14字节
;  数据转换日期  : 2014-6-17 19:47:28
------------------------------------------------------------------------------*/
0x07,0x0D,0x01,//宽的像素数,高的像素数，宽的字节数，参数设置可选
0x04,0xFC,0x04,0x04,0x08,0xF0,0x00,0x04,0x07,0x04,0x04,0x02,0x01,0x00,

/*------------------------------------------------------------------------------
;  若数据乱码，请检查字模格式设置，注意选择正确的取模方向和字节位顺序。
;  源文件 / 文字 : E
;  宽×高（像素）: 7×13
;  字模格式/大小 : 单色点阵液晶字模，纵向取模，字节倒序/14字节
;  数据转换日期  : 2014-6-17 19:47:28
------------------------------------------------------------------------------*/
0x07,0x0D,0x01,//宽的像素数,高的像素数，宽的字节数，参数设置可选
0x04,0xFC,0x44,0x44,0xE4,0x0C,0x00,0x04,0x07,0x04,0x04,0x04,0x06,0x00,

/*------------------------------------------------------------------------------
;  若数据乱码，请检查字模格式设置，注意选择正确的取模方向和字节位顺序。
;  源文件 / 文字 : F
;  宽×高（像素）: 7×13
;  字模格式/大小 : 单色点阵液晶字模，纵向取模，字节倒序/14字节
;  数据转换日期  : 2014-6-17 19:47:28
------------------------------------------------------------------------------*/
0x07,0x0D,0x01,//宽的像素数,高的像素数，宽的字节数，参数设置可选
0x04,0xFC,0x44,0x44,0xE4,0x0C,0x00,0x04,0x07,0x04,0x00,0x00,0x00,0x00,

/*------------------------------------------------------------------------------
;  若数据乱码，请检查字模格式设置，注意选择正确的取模方向和字节位顺序。
;  源文件 / 文字 : G
;  宽×高（像素）: 7×13
;  字模格式/大小 : 单色点阵液晶字模，纵向取模，字节倒序/14字节
;  数据转换日期  : 2014-6-17 19:47:28
------------------------------------------------------------------------------*/
0x07,0x0D,0x01,//宽的像素数,高的像素数，宽的字节数，参数设置可选
0xF0,0x08,0x04,0x84,0x8C,0x80,0x00,0x01,0x02,0x04,0x04,0x03,0x00,0x00,

/*------------------------------------------------------------------------------
;  若数据乱码，请检查字模格式设置，注意选择正确的取模方向和字节位顺序。
;  源文件 / 文字 : H
;  宽×高（像素）: 7×13
;  字模格式/大小 : 单色点阵液晶字模，纵向取模，字节倒序/14字节
;  数据转换日期  : 2014-6-17 19:47:28
------------------------------------------------------------------------------*/
0x07,0x0D,0x01,//宽的像素数,高的像素数，宽的字节数，参数设置可选
0x04,0xFC,0x44,0x40,0x44,0xFC,0x04,0x04,0x07,0x04,0x00,0x04,0x07,0x04,

/*------------------------------------------------------------------------------
;  若数据乱码，请检查字模格式设置，注意选择正确的取模方向和字节位顺序。
;  源文件 / 文字 : I
;  宽×高（像素）: 7×13
;  字模格式/大小 : 单色点阵液晶字模，纵向取模，字节倒序/14字节
;  数据转换日期  : 2014-6-17 19:47:28
------------------------------------------------------------------------------*/
0x07,0x0D,0x01,//宽的像素数,高的像素数，宽的字节数，参数设置可选
0x00,0x04,0x04,0xFC,0x04,0x04,0x00,0x00,0x04,0x04,0x07,0x04,0x04,0x00,

/*------------------------------------------------------------------------------
;  若数据乱码，请检查字模格式设置，注意选择正确的取模方向和字节位顺序。
;  源文件 / 文字 : J
;  宽×高（像素）: 7×13
;  字模格式/大小 : 单色点阵液晶字模，纵向取模，字节倒序/14字节
;  数据转换日期  : 2014-6-17 19:47:28
------------------------------------------------------------------------------*/
0x07,0x0D,0x01,//宽的像素数,高的像素数，宽的字节数，参数设置可选
0x00,0x04,0x04,0xFC,0x04,0x04,0x00,0x0C,0x08,0x08,0x07,0x00,0x00,0x00,

/*------------------------------------------------------------------------------
;  若数据乱码，请检查字模格式设置，注意选择正确的取模方向和字节位顺序。
;  源文件 / 文字 : K
;  宽×高（像素）: 7×13
;  字模格式/大小 : 单色点阵液晶字模，纵向取模，字节倒序/14字节
;  数据转换日期  : 2014-6-17 19:47:28
------------------------------------------------------------------------------*/
0x07,0x0D,0x01,//宽的像素数,高的像素数，宽的字节数，参数设置可选
0x04,0xFC,0x64,0xD0,0x0C,0x04,0x00,0x04,0x07,0x04,0x00,0x07,0x04,0x00,

/*------------------------------------------------------------------------------
;  若数据乱码，请检查字模格式设置，注意选择正确的取模方向和字节位顺序。
;  源文件 / 文字 : L
;  宽×高（像素）: 7×13
;  字模格式/大小 : 单色点阵液晶字模，纵向取模，字节倒序/14字节
;  数据转换日期  : 2014-6-17 19:47:28
------------------------------------------------------------------------------*/
0x07,0x0D,0x01,//宽的像素数,高的像素数，宽的字节数，参数设置可选
0x04,0xFC,0x04,0x00,0x00,0x00,0x00,0x04,0x07,0x04,0x04,0x04,0x06,0x00,

/*------------------------------------------------------------------------------
;  若数据乱码，请检查字模格式设置，注意选择正确的取模方向和字节位顺序。
;  源文件 / 文字 : M
;  宽×高（像素）: 7×13
;  字模格式/大小 : 单色点阵液晶字模，纵向取模，字节倒序/14字节
;  数据转换日期  : 2014-6-17 19:47:28
------------------------------------------------------------------------------*/
0x07,0x0D,0x01,//宽的像素数,高的像素数，宽的字节数，参数设置可选
0x04,0xFC,0x3C,0xC0,0x3C,0xFC,0x04,0x04,0x07,0x00,0x07,0x00,0x07,0x04,

/*------------------------------------------------------------------------------
;  若数据乱码，请检查字模格式设置，注意选择正确的取模方向和字节位顺序。
;  源文件 / 文字 : N
;  宽×高（像素）: 7×13
;  字模格式/大小 : 单色点阵液晶字模，纵向取模，字节倒序/14字节
;  数据转换日期  : 2014-6-17 19:47:28
------------------------------------------------------------------------------*/
0x07,0x0D,0x01,//宽的像素数,高的像素数，宽的字节数，参数设置可选
0x04,0xFC,0x1C,0xE0,0x04,0xFC,0x04,0x04,0x07,0x04,0x00,0x03,0x07,0x00,

/*------------------------------------------------------------------------------
;  若数据乱码，请检查字模格式设置，注意选择正确的取模方向和字节位顺序。
;  源文件 / 文字 : O
;  宽×高（像素）: 7×13
;  字模格式/大小 : 单色点阵液晶字模，纵向取模，字节倒序/14字节
;  数据转换日期  : 2014-6-17 19:47:28
------------------------------------------------------------------------------*/
0x07,0x0D,0x01,//宽的像素数,高的像素数，宽的字节数，参数设置可选
0xF0,0x08,0x04,0x04,0x08,0xF0,0x00,0x01,0x02,0x04,0x04,0x02,0x01,0x00,

/*------------------------------------------------------------------------------
;  若数据乱码，请检查字模格式设置，注意选择正确的取模方向和字节位顺序。
;  源文件 / 文字 : P
;  宽×高（像素）: 7×13
;  字模格式/大小 : 单色点阵液晶字模，纵向取模，字节倒序/14字节
;  数据转换日期  : 2014-6-17 19:47:28
------------------------------------------------------------------------------*/
0x07,0x0D,0x01,//宽的像素数,高的像素数，宽的字节数，参数设置可选
0x04,0xFC,0x44,0x44,0x44,0x38,0x00,0x04,0x07,0x04,0x00,0x00,0x00,0x00,

/*------------------------------------------------------------------------------
;  若数据乱码，请检查字模格式设置，注意选择正确的取模方向和字节位顺序。
;  源文件 / 文字 : Q
;  宽×高（像素）: 7×13
;  字模格式/大小 : 单色点阵液晶字模，纵向取模，字节倒序/14字节
;  数据转换日期  : 2014-6-17 19:47:28
------------------------------------------------------------------------------*/
0x07,0x0D,0x01,//宽的像素数,高的像素数，宽的字节数，参数设置可选
0xF0,0x08,0x04,0x04,0x08,0xF0,0x00,0x01,0x02,0x05,0x05,0x0E,0x09,0x00,

/*------------------------------------------------------------------------------
;  若数据乱码，请检查字模格式设置，注意选择正确的取模方向和字节位顺序。
;  源文件 / 文字 : R
;  宽×高（像素）: 7×13
;  字模格式/大小 : 单色点阵液晶字模，纵向取模，字节倒序/14字节
;  数据转换日期  : 2014-6-17 19:47:28
------------------------------------------------------------------------------*/
0x07,0x0D,0x01,//宽的像素数,高的像素数，宽的字节数，参数设置可选
0x04,0xFC,0x24,0x64,0xA4,0x18,0x00,0x04,0x07,0x04,0x00,0x01,0x06,0x04,

/*------------------------------------------------------------------------------
;  若数据乱码，请检查字模格式设置，注意选择正确的取模方向和字节位顺序。
;  源文件 / 文字 : S
;  宽×高（像素）: 7×13
;  字模格式/大小 : 单色点阵液晶字模，纵向取模，字节倒序/14字节
;  数据转换日期  : 2014-6-17 19:47:28
------------------------------------------------------------------------------*/
0x07,0x0D,0x01,//宽的像素数,高的像素数，宽的字节数，参数设置可选
0x00,0x18,0x24,0x44,0x44,0x8C,0x00,0x00,0x06,0x04,0x04,0x04,0x03,0x00,

/*------------------------------------------------------------------------------
;  若数据乱码，请检查字模格式设置，注意选择正确的取模方向和字节位顺序。
;  源文件 / 文字 : T
;  宽×高（像素）: 7×13
;  字模格式/大小 : 单色点阵液晶字模，纵向取模，字节倒序/14字节
;  数据转换日期  : 2014-6-17 19:47:28
------------------------------------------------------------------------------*/
0x07,0x0D,0x01,//宽的像素数,高的像素数，宽的字节数，参数设置可选
0x00,0x0C,0x04,0xFC,0x04,0x0C,0x00,0x00,0x00,0x04,0x07,0x04,0x00,0x00,

/*------------------------------------------------------------------------------
;  若数据乱码，请检查字模格式设置，注意选择正确的取模方向和字节位顺序。
;  源文件 / 文字 : U
;  宽×高（像素）: 7×13
;  字模格式/大小 : 单色点阵液晶字模，纵向取模，字节倒序/14字节
;  数据转换日期  : 2014-6-17 19:47:28
------------------------------------------------------------------------------*/
0x07,0x0D,0x01,//宽的像素数,高的像素数，宽的字节数，参数设置可选
0x04,0xFC,0x04,0x00,0x04,0xFC,0x04,0x00,0x03,0x04,0x04,0x04,0x03,0x00,

/*------------------------------------------------------------------------------
;  若数据乱码，请检查字模格式设置，注意选择正确的取模方向和字节位顺序。
;  源文件 / 文字 : V
;  宽×高（像素）: 7×13
;  字模格式/大小 : 单色点阵液晶字模，纵向取模，字节倒序/14字节
;  数据转换日期  : 2014-6-17 19:47:28
------------------------------------------------------------------------------*/
0x07,0x0D,0x01,//宽的像素数,高的像素数，宽的字节数，参数设置可选
0x04,0x1C,0xE4,0x00,0xE4,0x1C,0x04,0x00,0x00,0x01,0x06,0x01,0x00,0x00,

/*------------------------------------------------------------------------------
;  若数据乱码，请检查字模格式设置，注意选择正确的取模方向和字节位顺序。
;  源文件 / 文字 : W
;  宽×高（像素）: 7×13
;  字模格式/大小 : 单色点阵液晶字模，纵向取模，字节倒序/14字节
;  数据转换日期  : 2014-6-17 19:47:28
------------------------------------------------------------------------------*/
0x07,0x0D,0x01,//宽的像素数,高的像素数，宽的字节数，参数设置可选
0x04,0xFC,0x80,0x7C,0x80,0xFC,0x04,0x00,0x00,0x07,0x00,0x07,0x00,0x00,

/*------------------------------------------------------------------------------
;  若数据乱码，请检查字模格式设置，注意选择正确的取模方向和字节位顺序。
;  源文件 / 文字 : X
;  宽×高（像素）: 7×13
;  字模格式/大小 : 单色点阵液晶字模，纵向取模，字节倒序/14字节
;  数据转换日期  : 2014-6-17 19:47:28
------------------------------------------------------------------------------*/
0x07,0x0D,0x01,//宽的像素数,高的像素数，宽的字节数，参数设置可选
0x04,0x1C,0xE0,0xE4,0x1C,0x04,0x00,0x04,0x07,0x04,0x00,0x07,0x04,0x00,

/*------------------------------------------------------------------------------
;  若数据乱码，请检查字模格式设置，注意选择正确的取模方向和字节位顺序。
;  源文件 / 文字 : Y
;  宽×高（像素）: 7×13
;  字模格式/大小 : 单色点阵液晶字模，纵向取模，字节倒序/14字节
;  数据转换日期  : 2014-6-17 19:47:28
------------------------------------------------------------------------------*/
0x07,0x0D,0x01,//宽的像素数,高的像素数，宽的字节数，参数设置可选
0x04,0x0C,0x34,0xC0,0x34,0x0C,0x04,0x00,0x00,0x04,0x07,0x04,0x00,0x00,

/*------------------------------------------------------------------------------
;  若数据乱码，请检查字模格式设置，注意选择正确的取模方向和字节位顺序。
;  源文件 / 文字 : Z
;  宽×高（像素）: 7×13
;  字模格式/大小 : 单色点阵液晶字模，纵向取模，字节倒序/14字节
;  数据转换日期  : 2014-6-17 19:47:28
------------------------------------------------------------------------------*/
0x07,0x0D,0x01,//宽的像素数,高的像素数，宽的字节数，参数设置可选
0x00,0x0C,0x04,0xE4,0x1C,0x04,0x00,0x00,0x04,0x07,0x04,0x04,0x06,0x00,

/*------------------------------------------------------------------------------
;  若数据乱码，请检查字模格式设置，注意选择正确的取模方向和字节位顺序。
;  源文件 / 文字 :  
;  宽×高（像素）: 7×13
;  字模格式/大小 : 单色点阵液晶字模，纵向取模，字节倒序/14字节
;  数据转换日期  : 2014-6-17 19:47:28
------------------------------------------------------------------------------*/
0x07,0x0D,0x01,//宽的像素数,高的像素数，宽的字节数，参数设置可选
0x00,0x00,0x00,0x00,0x00,0x00,0x00,0x00,0x00,0x00,0x00,0x00,0x00,0x00,

/*------------------------------------------------------------------------------
;  若数据乱码，请检查字模格式设置，注意选择正确的取模方向和字节位顺序。
;  源文件 / 文字 : ? 
;  宽×高（像素）: 7×13
;  字模格式/大小 : 单色点阵液晶字模，纵向取模，字节倒序/14字节
;  数据转换日期  : 2014-6-17 19:47:28
------------------------------------------------------------------------------*/
0x07,0x0D,0x01,//宽的像素数,高的像素数，宽的字节数，参数设置可选
0x00,0x08,0x04,0xC4,0x24,0x18,0x00,0x00,0x00,0x00,0x05,0x00,0x00,0x00
};

 

 

 

/////////////////////////////////////////////////////////////////////////////////////////////////////////////////



/////////////////////////////////////////////////////////////////////////////////////////////////////////////////
 
uint8_t s_ucGRAM[4][128]; 
void OLED_Clear(void);

void LCD_WriteCMD(unsigned char command)
{
	SPI_Delay(1);
	LCD_CS_0;                   
	LCD_DC_0;		// command write
	SPI_Write(command);
	LCD_CS_1;
}


void LCD_WriteDATA(unsigned char command)
{
	SPI_Delay(1);
	LCD_CS_0;                   
	LCD_DC_1;		// command write
	SPI_Write(command);
	LCD_CS_1;
}

 
 

void OLED_Init(void)
{   
	LCD_On();
	driver_delay_xms(10); 
 	LCD_RST_0;					// Module reset
	driver_delay_xms(50);
	LCD_RST_1;
	driver_delay_xms(50); 

	LCD_WriteCMD(0XAE);		//Set Display Off
	LCD_WriteCMD(0X00);
	LCD_WriteCMD(0X10);	
	LCD_WriteCMD(0X00);	

	LCD_WriteCMD(0X81);	
	LCD_WriteCMD(0Xff);	
	
	LCD_WriteCMD(0XA0);	
	LCD_WriteCMD(0XC0);		
	
	LCD_WriteCMD(0XA6);	
	
	LCD_WriteCMD(0XA8);		
	LCD_WriteCMD(0X1F);			
	
	LCD_WriteCMD(0xD3);	/* 设置显示偏移（双字节命令）*/
	LCD_WriteCMD(0x00);	/* 无偏移 */

	LCD_WriteCMD(0xD5);	/* 设置显示时钟分频系数/振荡频率 */
	LCD_WriteCMD(0x80);	/* 设置分频系数,高4bit是分频系数，低4bit是振荡频率 */

	LCD_WriteCMD(0xD9);	/* 设置预充电周期 */
	LCD_WriteCMD(0x04);	/* [3:0],PHASE 1; [7:4],PHASE 2; */

	LCD_WriteCMD(0xDA);	/* 设置COM脚硬件接线方式 */
	LCD_WriteCMD(0x00);

	LCD_WriteCMD(0xDB);	/* 设置 vcomh 电压倍率 */
	LCD_WriteCMD(0x30);	/* [6:4] 000 = 0.65 x VCC; 0.77 x VCC (RESET); 0.83 x VCC  */

	LCD_WriteCMD(0x8D);	/* 设置充电泵（和下个命令结合使用） */
	LCD_WriteCMD(0x14);	/* 0x14 使能充电泵， 0x10 是关闭 */
	LCD_WriteCMD(0xAF);	/* 打开OLED面板 */ 
}

void OLED_ClrScr(uint8_t _ucMode)
{
	uint8_t i,j;

	LCD_WriteCMD(0xAE);	/* 关闭OLED面板 */
	for (i = 0 ; i< 4; i++)
	{
		LCD_WriteCMD (0xB0 + i);	/* 设置页地址（0~7） */
		LCD_WriteCMD (0x00);		/* 设置列地址的低地址 */
		LCD_WriteCMD (0x10);		/* 设置列地址的高地址 */
		
		for (j = 0 ; j < 128; j++)
		{
			LCD_WriteDATA(_ucMode);
		}
	}
	
	for(i = 0 ; i< 4; i++)
	{
		for (j = 0 ; j < 128; j++)
					s_ucGRAM[i][j] = 0;
	}
	LCD_WriteCMD(0xAF);	/* 打开OLED面板 */
}
 
/***********************************************************
						end file
***********************************************************/
 
 /*
*********************************************************************************************************
*	函 数 名: OLED_DispOn
*	功能说明: 打开显示
*	形    参:无
*	返 回 值: 无
*********************************************************************************************************
*/
void OLED_DispOn(void)
{
	LCD_WriteCMD(0x8D);	/* 设置充电泵（和下个命令结合使用） */
	LCD_WriteCMD(0x14);	/* 0x14 使能充电泵， 0x10 是关闭 */
	LCD_WriteCMD(0xAF);	/* 打开OLED面板 */
}

/*
*********************************************************************************************************
*	函 数 名: OLED_DispOff
*	功能说明: 关闭显示
*	形    参: 无
*	返 回 值: 无
*********************************************************************************************************
*/
void OLED_DispOff(void)
{
	LCD_WriteCMD(0x8D);	/* 设置充电泵（和下个命令结合使用）*/
	LCD_WriteCMD(0x10);	/* 0x14 使能充电泵，0x10 是关闭 */
	LCD_WriteCMD(0xAE);	/* 关闭OLED面板 */
}

/*
*********************************************************************************************************
*	函 数 名: OLED_SetDir
*	功能说明: 设置显示方向
*	形    参: _ucDir = 0 表示正常方向，1表示翻转180度
*	返 回 值: 无
*********************************************************************************************************
*/
void OLED_SetDir(uint8_t _ucDir)
{
	if (_ucDir == 0)
	{
		LCD_WriteCMD(0xA0);	/* A0 ：列地址0映射到SEG0; A1 ：列地址127映射到SEG0 */
		LCD_WriteCMD(0xC0);	/* C0 ：正常扫描,从COM0到COM63;  C8 : 反向扫描, 从 COM63至 COM0 */
	}
	else
	{
		LCD_WriteCMD(0xA1);	/* A0 ：列地址0映射到SEG0; A1 ：列地址127映射到SEG0 */
		LCD_WriteCMD(0xC8);	/* C0 ：正常扫描,从COM0到COM63;  C8 : 反向扫描, 从 COM63至 COM0 */
	}
}
 
/*
*********************************************************************************************************
*	函 数 名: OLED_DispStr
*	功能说明: 在屏幕指定坐标（左上角为0，0）显示一个字符串
*	形    参:
*		_usX : X坐标，对于12832屏，范围为【0 - 127】
*		_usY : Y坐标，对于12832屏，范围为【0 - 3】
*		_ptr  : 字模开始地址指针
                len ：  1行的宽度
*	返 回 值: 无
*********************************************************************************************************
*/
void OLED_DispStr(uint16_t _usX, uint16_t _usY, unsigned char str, char len)
{
	unsigned char i;
	unsigned char *_ptr;
	if ((str>='0') && (str<='9'))
	{
		_ptr=(unsigned char *)&Bmp001[str-0x30][3];
	}
	else if((str=='.'))
	{
		_ptr=(unsigned char *)&Bmp001[10][3];
	}
	else if((str==':'))
	{
		_ptr=(unsigned char *)&Bmp001[11][3];
	}
	else if ((str>='A') && (str<='Z'))
	{
		_ptr=(unsigned char *)&Bmp001[str-'A'+12][3];
	}
	else if((str==' '))
	{
		_ptr=(unsigned char *)&Bmp001[38][3];
	}
	else if((str=='?'))
	{
		_ptr=(unsigned char *)&Bmp001[39][3];
	}
	else return;
	
	for(i=0;i<len;i++)
	{
		s_ucGRAM[_usY][_usX+i]=*(_ptr+i);
	}
	_ptr=_ptr+len;
	for(i=0;i<len;i++)
	{
		s_ucGRAM[_usY+1][_usX+i]=*(_ptr+i);
	}
}


void OLED_DispStrs(uint16_t _usX, uint16_t _usY, const char *stringsdata,unsigned char lengthdata)
{
	unsigned char i;
	for(i=0;i<lengthdata;i++)
	{
		OLED_DispStr(i*8+_usX, _usY, *(stringsdata+i), 7);
	}
}


/*
*********************************************************************************************************
*	函 数 名: OLED_DrawLineH
*	功能说明: 绘制一条水平线
*	形    参: _ucX, _ucY ：起始点坐标
*			  _ucLen     ：长度
                  lab    =0 擦除 =1 画线
*	返 回 值: 无
*********************************************************************************************************
*/
void OLED_DrawLine(uint8_t _ucX, uint8_t _ucY, uint8_t _ucLen, unsigned char lab)
{
  unsigned char i;
  if (lab==0)
  {
    for(i=0;i<_ucLen;i++)
      s_ucGRAM[_ucY][_ucX+i]=s_ucGRAM[_ucY][_ucX+i]& 0x7f;
  }
  else
  {
      for(i=0;i<_ucLen;i++)
      s_ucGRAM[_ucY][_ucX+i]=s_ucGRAM[_ucY][_ucX+i]| 0x80;
  }
}


/*
*********************************************************************************************************
*	函 数 名: OLED_DisPic
*	功能说明: 在LCD上显示整屏图片
*	形    参:
*			_ptr       ：单色图片点阵指针
*	返 回 值: 无
*********************************************************************************************************
*/
void OLED_DisPic(unsigned char *pict)
{
	unsigned long i,j;
	
	for(i=0;i<128;i++)
	{
		for(j=0;j<4;j++)
			s_ucGRAM[j][i]=*(pict+j*128+i);
	}
}


/*
*********************************************************************************************************
*	函 数 名: OLED_DisFont
*	功能说明: 在LCD上显示汉字
*	形    参:
*		_ucX : X坐标，对于12832屏，范围为【0 - 127】,位个数
*		_ucY : Y坐标，对于12832屏，范围为【0 - 3】,字节个数
*   width: 汉字宽度
*   height：汉字高度
*		font  : 字模开始地址指针
      len ：一行汉字个数
*	返 回 值: 无
*********************************************************************************************************
*/
void OLED_DisFont(uint8_t _ucX, uint8_t _ucY, uint8_t width, uint8_t height,unsigned char *font, uint8_t len)
{
	unsigned long i,j,k;
	unsigned long n,m;
	
	n = height/8;
	m = width*height/8;
		
	for(i=0;i<len;i++)				//汉字个数
	{
		for(j=0;j<width;j++)		//汉字宽度
		{
			for(k=0;k<n;k++)			//汉字高度
				s_ucGRAM[_ucY+k][_ucX+i*width+j]=*(font+i*m+k*width+j);
		}		
	}
}
/*
*********************************************************************************************************
*	函 数 名: OLED_DrawBMP
*	功能说明: 在LCD上显示一个BMP位图，位图点阵扫描次序：从左到右，从上到下
*	形    参:
*	返 回 值: 无
*********************************************************************************************************
*/
void OLED_DrawBMP(void)
{
	uint8_t i,j; 
	for (i = 0 ; i< 4; i++)
	{
		LCD_WriteCMD (0xB0 + i);/* 设置页地址（0~3） */
		LCD_WriteCMD (0x00);		/* 设置列地址的低地址 */
		LCD_WriteCMD (0x10);		/* 设置列地址的高地址 */ 
		for (j = 0 ; j < 128; j++)
		{
			LCD_WriteDATA(s_ucGRAM[i][j]);
		}
	} 
} 

uint8_t OLED_Display_sensor(uint8_t Hr,uint32_t step)
{
	uint8_t x=0,y=0,z=0,w=0,m=0;
 	char str_steps[2]="S:";
	char str_heartrate[2]="H:";
	//英文字符串显示
	if((Hr>110)||(Hr<50)) 
	{
		OLED_ClrScr(0xff);			//清屏
		OLED_DrawBMP();					//显示加载
		return 0; 
	}
	 
	if(30<Hr<110)
	{ 
		//英文字符串显示
		OLED_ClrScr(0xff);			//清屏
		OLED_DispStrs(1,1,str_heartrate,2);// 
		if(Hr>=100) 
		{
			x=Hr/100;			//百位
			y=(Hr/10)%10;	//十位
			z=Hr%100;			//个位
			OLED_DisFont(15,1,8,16,(unsigned char *)&num[x*8*16/8],1);//0~9数字轮流显示 8*16分辨率
			OLED_DisFont(25,1,8,16,(unsigned char *)&num[y*8*16/8],1);//0~9数字轮流显示 8*16分辨率
			OLED_DisFont(35,1,8,16,(unsigned char *)&num[z*8*16/8],1);//0~9数字轮流显示 8*16分辨率
		}
		if(Hr<100)
		{
			y=Hr/10;
			z=Hr%10;
			OLED_DisFont(15,1,8,16,(unsigned char *)&num[y*8*16/8],1);//0~9数字轮流显示 8*16分辨率
			OLED_DisFont(25,1,8,16,(unsigned char *)&num[z*8*16/8],1);//0~9数字轮流显示 8*16分辨率
		} 
	}
	
	if(0<step<15000)
	{ 
		OLED_DispStrs(55,1,str_steps,10); 
		if((step>=10000)&&(step<99999)) 
		{
			m=step/10000;				//万位
			w=(step/1000)%10;		//千位
			x=(step/100)%10;//百位
			y=(step/10)%10;	//十位
			z=step%10;			//个位
			OLED_DisFont(70,1,8,16,(unsigned char *)&num[m*8*16/8],1);//0~9数字轮流显示 8*16分辨率
			OLED_DisFont(80,1,8,16,(unsigned char *)&num[w*8*16/8],1);//0~9数字轮流显示 8*16分辨率
			OLED_DisFont(90,1,8,16,(unsigned char *)&num[x*8*16/8],1);//0~9数字轮流显示 8*16分辨率
			OLED_DisFont(100,1,8,16,(unsigned char *)&num[y*8*16/8],1);//0~9数字轮流显示 8*16分辨率
			OLED_DisFont(110,1,8,16,(unsigned char *)&num[z*8*16/8],1);//0~9数字轮流显示 8*16分辨率
		}
		if((step>=1000)&&(step<9999)) 
		{
			w=step/1000;		//千位
			x=(step/100)%10;//百位
			y=(step/10)%10;	//十位
			z=step%10;			//个位
			OLED_DisFont(70,1,8,16,(unsigned char *)&num[w*8*16/8],1);//0~9数字轮流显示 8*16分辨率
			OLED_DisFont(80,1,8,16,(unsigned char *)&num[x*8*16/8],1);//0~9数字轮流显示 8*16分辨率
			OLED_DisFont(90,1,8,16,(unsigned char *)&num[y*8*16/8],1);//0~9数字轮流显示 8*16分辨率
			OLED_DisFont(100,1,8,16,(unsigned char *)&num[z*8*16/8],1);//0~9数字轮流显示 8*16分辨率
		}
		if((step>=100)&&(step<999)) 
		{ 
			x=(step/100)%10;//百位
			y=(step/10)%10;	//十位
			z=step%10;			//个位 
			OLED_DisFont(70,1,8,16,(unsigned char *)&num[x*8*16/8],1);//0~9数字轮流显示 8*16分辨率
			OLED_DisFont(80,1,8,16,(unsigned char *)&num[y*8*16/8],1);//0~9数字轮流显示 8*16分辨率
			OLED_DisFont(90,1,8,16,(unsigned char *)&num[z*8*16/8],1);//0~9数字轮流显示 8*16分辨率
		}
		if(step<100)
		{
			y=step/10;
			z=step%10;
			OLED_DisFont(70,1,8,16,(unsigned char *)&num[y*8*16/8],1);//0~9数字轮流显示 8*16分辨率
			OLED_DisFont(80,1,8,16,(unsigned char *)&num[z*8*16/8],1);//0~9数字轮流显示 8*16分辨率
		}		 
	}
	OLED_DrawBMP();//显示加载		
	return 1;
}

void OLED_Display(const char *str)
{
	//英文字符串显示
	OLED_ClrScr(0xff);			//清屏
	OLED_DispStrs(12,1,str,strlen(str));// 
	OLED_DrawBMP();//显示加载
}
