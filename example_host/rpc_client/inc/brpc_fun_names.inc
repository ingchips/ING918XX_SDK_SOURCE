case 1001: return "platform_reset";
case 1002: return "platform_switch_app";
case 1003: return "platform_write_persistent_reg";
case 1004: return "platform_read_persistent_reg";
case 1005: return "platform_config";
case 1006: return "platform_read_info";
case 1007: return "platform_calibrate_rt_clk";
case 1008: return "platform_rt_rc_tune";
case 1009: return "platform_rt_rc_auto_tune";
case 1010: return "platform_rand";
case 1011: return "platform_get_us_time";
case 1012: return "platform_set_rf_clk_source";
case 1013: return "platform_get_task_handle";
case 1014: return "gap_set_random_device_address";
case 1015: return "gap_disconnect";
case 1016: return "gap_disconnect_all";
case 1017: return "gap_add_whitelist";
case 1018: return "gap_remove_whitelist";
case 1019: return "gap_clear_white_lists";
case 1020: return "gap_read_rssi";
case 1021: return "gap_read_remote_used_features";
case 1022: return "gap_read_remote_version";
case 1023: return "gap_le_read_channel_map";
case 1024: return "gap_read_phy";
case 1025: return "gap_set_def_phy";
case 1026: return "gap_set_phy";
case 1027: return "gap_set_adv_set_random_addr";
case 1028: return "gap_set_ext_scan_para";
case 1029: return "gap_set_ext_scan_response_data";
case 1030: return "gap_set_ext_scan_enable";
case 1031: return "gap_set_ext_adv_enable";
case 1032: return "gap_set_ext_adv_para";
case 1033: return "gap_set_ext_adv_data";
case 1034: return "gap_set_periodic_adv_data";
case 1035: return "gap_set_periodic_adv_enable";
case 1036: return "gap_set_periodic_adv_para";
case 1037: return "gap_clr_adv_set";
case 1038: return "gap_rmv_adv_set";
case 1039: return "gap_periodic_adv_create_sync";
case 1040: return "gap_periodic_adv_create_sync_cancel";
case 1041: return "gap_periodic_adv_term_sync";
case 1042: return "gap_add_dev_to_periodic_list";
case 1043: return "gap_rmv_dev_from_periodic_list";
case 1044: return "gap_clr_periodic_adv_list";
case 1045: return "gap_read_periodic_adv_list_size";
case 1046: return "gap_ext_create_connection";
case 1047: return "gap_create_connection_cancel";
case 1048: return "gap_set_data_length";
case 1049: return "gap_set_connectionless_cte_tx_param";
case 1050: return "gap_set_connectionless_cte_tx_enable";
case 1051: return "gap_set_connectionless_iq_sampling_enable";
case 1052: return "gap_set_connection_cte_rx_param";
case 1053: return "gap_set_connection_cte_tx_param";
case 1054: return "gap_set_connection_cte_request_enable";
case 1055: return "gap_set_connection_cte_response_enable";
case 1056: return "gap_read_antenna_info";
case 1057: return "gap_set_periodic_adv_rx_enable";
case 1058: return "gap_periodic_adv_sync_transfer";
case 1059: return "gap_periodic_adv_set_info_transfer";
case 1060: return "gap_periodic_adv_sync_transfer_param";
case 1061: return "gap_default_periodic_adv_sync_transfer_param";
case 1062: return "gap_set_host_channel_classification";
case 1063: return "gap_update_connection_parameters";
case 1064: return "gap_get_connection_parameter_range";
case 1065: return "gap_set_connection_parameter_range";
case 1066: return "gap_read_local_tx_power_level";
case 1067: return "gap_read_remote_tx_power_level";
case 1068: return "gap_set_path_loss_reporting_param";
case 1069: return "gap_set_path_loss_reporting_enable";
case 1070: return "gap_set_tx_power_reporting_enable";
case 1071: return "gap_set_default_subrate";
case 1072: return "gap_subrate_request";
case 1073: return "gap_aes_encrypt";
case 1074: return "gap_rx_test_v2";
case 1075: return "gap_rx_test_v3";
case 1076: return "gap_tx_test_v2";
case 1077: return "gap_tx_test_v4";
case 1078: return "gap_test_end";
case 1079: return "gap_vendor_tx_continuous_wave";
case 1080: return "att_server_deferred_read_response";
case 1081: return "att_server_notify";
case 1082: return "att_server_indicate";
case 1083: return "att_server_get_mtu";
case 1084: return "gatt_client_discover_primary_services";
case 1085: return "gatt_client_discover_primary_services_by_uuid16";
case 1086: return "gatt_client_discover_primary_services_by_uuid128";
case 1087: return "gatt_client_find_included_services_for_service";
case 1088: return "gatt_client_discover_characteristics_for_service";
case 1089: return "gatt_client_discover_characteristics_for_handle_range_by_uuid16";
case 1090: return "gatt_client_discover_characteristics_for_handle_range_by_uuid128";
case 1091: return "gatt_client_discover_characteristic_descriptors";
case 1092: return "gatt_client_read_value_of_characteristic_using_value_handle";
case 1093: return "gatt_client_read_value_of_characteristics_by_uuid16";
case 1094: return "gatt_client_read_value_of_characteristics_by_uuid128";
case 1095: return "gatt_client_read_long_value_of_characteristic_using_value_handle";
case 1096: return "gatt_client_read_long_value_of_characteristic_using_value_handle_with_offset";
case 1097: return "gatt_client_read_multiple_characteristic_values";
case 1098: return "gatt_client_write_value_of_characteristic_without_response";
case 1099: return "gatt_client_signed_write_without_response";
case 1100: return "gatt_client_write_value_of_characteristic";
case 1101: return "gatt_client_write_long_value_of_characteristic";
case 1102: return "gatt_client_write_long_value_of_characteristic_with_offset";
case 1103: return "gatt_client_reliable_write_long_value_of_characteristic";
case 1104: return "gatt_client_read_characteristic_descriptor_using_descriptor_handle";
case 1105: return "gatt_client_read_long_characteristic_descriptor_using_descriptor_handle";
case 1106: return "gatt_client_read_long_characteristic_descriptor_using_descriptor_handle_with_offset";
case 1107: return "gatt_client_write_characteristic_descriptor_using_descriptor_handle";
case 1108: return "gatt_client_write_long_characteristic_descriptor_using_descriptor_handle";
case 1109: return "gatt_client_write_long_characteristic_descriptor_using_descriptor_handle_with_offset";
case 1110: return "gatt_client_write_client_characteristic_configuration";
case 1111: return "gatt_client_prepare_write";
case 1112: return "gatt_client_execute_write";
case 1113: return "gatt_client_cancel_write";
case 1114: return "gatt_client_is_ready";
case 1115: return "gatt_client_listen_for_characteristic_value_updates";
case 1116: return "sm_config";
case 1117: return "sm_private_random_address_generation_set_mode";
case 1118: return "sm_private_random_address_generation_get_mode";
case 1119: return "sm_private_random_address_generation_set_update_period";
case 1120: return "sm_set_accepted_stk_generation_methods";
case 1121: return "sm_set_encryption_key_size_range";
case 1122: return "sm_set_authentication_requirements";
case 1123: return "sm_address_resolution_lookup";
case 1124: return "sm_config_conn";
case 1125: return "sm_bonding_decline";
case 1126: return "sm_just_works_confirm";
case 1127: return "sm_passkey_input";
case 1128: return "sm_send_security_request";
case 1129: return "sm_encryption_key_size";
case 1130: return "sm_authenticated";
case 1131: return "sm_authorization_state";
case 1132: return "sm_request_pairing";
case 1133: return "sm_authorization_decline";
case 1134: return "sm_authorization_grant";
case 1135: return "sm_le_device_key";
case 1136: return "kv_remove_all";
case 1137: return "kv_remove";
case 1138: return "kv_put";
case 1139: return "kv_value_modified";
case 1140: return "kv_commit";
case 1141: return "le_device_db_remove_key";
